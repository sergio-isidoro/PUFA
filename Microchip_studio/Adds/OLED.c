/*
 * OLED.c
 *
 * Sergio Isidoro - 1221709
 * Andre Nogueira - 1221709
 *
 * CHIP: Atmega328p 8MHz
 */

#include "OLED.h"

void oled_command(uint8_t cmd) {
	I2C_start();							// Inicia a comunicação I2C
	I2C_write(OLED_ADDRESS << 1);			// Envia o endereço do OLED no modo de escrita
	I2C_write(0x00);						// Indica que o próximo byte é um comando
	I2C_write(cmd);							// Envia o comando para o OLED
	I2C_stop();								// Encerra a comunicação I2C
}

void oled_data(uint8_t data) {
	I2C_start();							// Inicia a comunicação I2C
	I2C_write(OLED_ADDRESS << 1);			// Envia o endereço do OLED com o bit de escrita
	I2C_write(0x40);						// Indica que o próximo byte é um dado
	I2C_write(data);						// Envia o dado para o OLED
	I2C_stop();								// Encerra a comunicação I2C
}

void oled_clear(void) {						// Limpa a tela
	uint8_t page = 0;						// Inicializa o contador de paginas
	
	while (page < 8) {						// Loop enquanto page for menor que 8
		oled_command(0xB0 + page);			// Seleciona a pagina (0 a 7)
		oled_command(0x00);					// Endereco de coluna baixo
		oled_command(0x10);					// Endereco de coluna alto

		uint8_t col = 0;					// Inicializa o contador de colunas
		while (col < 130) {					// Loop enquanto col for menor que 130
			oled_data(0x00);				// Envia o byte 0x00 (todos os pixels apagados)
			col++;							// Incrementa o contador
		}
		
		page++;								// Incrementa o contador de p?ginas
	}
}

void oled_init(void) {						// Inicializacao do OLED
	oled_command(0xAE);						// Display OFF
	oled_command(0xD5); 					// Set clock divide ratio/oscillator frequency
	oled_command(0x80);
	oled_command(0xA8); 					// Set multiplex ratio
	oled_command(0x3F); 					// 1/64 duty
	oled_command(0xD3); 					// Set display offset
	oled_command(0x00);
	oled_command(0x40); 					// Set start line address
	oled_command(0x8D); 					// Charge pump setting
	oled_command(0x14); 					// Enable charge pump
	oled_command(0x20); 					// Memory addressing mode
	oled_command(0x00); 					// Horizontal addressing mode
	oled_command(0xA1); 					// Set segment re-map
	oled_command(0xC8); 					// COM output scan direction
	oled_command(0xDA); 					// Set COM pins hardware configuration
	oled_command(0x12);
	oled_command(0x81); 					// Set contrast control
	oled_command(0x7F);
	oled_command(0xD9); 					// Set pre-charge period
	oled_command(0xF1);
	oled_command(0xDB); 					// Set VCOMH deselect level
	oled_command(0x40);
	oled_command(0xA4); 					// Resume RAM content display
	oled_command(0xA6); 					// Normal display
	oled_clear();        					// Limpa a tela (preto)
	oled_command(0xAF); 					// Display ON
}

void oled_set_cursor(uint8_t row, uint8_t col) {	// Define o cursor (linha e coluna)
	oled_command(0xB0 + row);						// Define a pagina (linha)
	oled_command(0x00 + (col & 0x0F));				// Define a coluna baixa
	oled_command(0x10 + ((col >> 4) & 0x0F));		// Define a coluna alta
}

const uint8_t font5x7[][5] PROGMEM = {
	{0x00, 0x00, 0x00, 0x00, 0x00}, // Espaco (ASCII 32)
	{0x00, 0x00, 0x5F, 0x00, 0x00}, // ! (ASCII 33)
	{0x00, 0x07, 0x00, 0x07, 0x00}, // " (ASCII 34)
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	{0x08, 0x1C, 0x2A, 0x08, 0x08}, // <- (ASCII 127)
};

void oled_print(char* str) {
	uint8_t used_pixels = 0;

	while (*str) {
		
		if (*str >= 32 && *str <= 127) {							// Verifica se o caractere esta dentro da faixa permitida
			uint8_t i = 0;											// Inicializa o contador
			while (i < 5) {											// Loop enquanto i for menor que 5
				oled_data(pgm_read_byte(&font5x7[*str - 32][i]));	// Enviar byte da fonte
				i++;												// Incrementa o contador
			}
			oled_data(0x00);										// Espaco entre caracteres
			used_pixels += 6;										// Incrementa os pixels usados (5 para caractere + 1 para espa?o)
		} else {
			uint8_t i = 0;											// Inicializa o contador
			while (i < 5) {											// Loop enquanto i for menor que 5
				oled_data(0x00);									// Espaco vazio para caracteres fora da faixa
				i++;												// Incrementa o contador
			}
			oled_data(0x00);										// Espaco entre caracteres
			used_pixels += 6;
		}
		str++;														// Avanca para o proximo caractere
	}

	while (used_pixels < 128) {										// Supondo linha com 128 pixels de largura
		oled_data(0x00);											// Espaco vazio para limpar o restante da linha
		used_pixels++;
	}
}